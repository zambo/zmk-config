// #include <behaviors.dtsi>
#include <dt-bindings/zmk/keys.h>
#include <dt-bindings/zmk/rgb.h>
#include <dt-bindings/zmk/bt.h>
#include <dt-bindings/zmk/outputs.h>

#define CONFIG_WIRELESS
#define HOST_OS 2

#include "zmk-helpers/helper.h"
#include "zmk-helpers/key-labels/eyelash42.h"
#include <behaviors/num_word.dtsi> // Requires auto-layer module.
#include "zmk-helpers/unicode-chars/greek.dtsi"
#include "zmk-helpers/unicode-chars/german.dtsi"
#include "zmk-helpers/unicode-chars/portuguese.dtsi"
#include "zmk-helpers/unicode-chars/currency.dtsi"

#define DEF   0
#define NAV   1
#define FN    2
#define NUM   3
#define SYS   4
#define MIC   5
#define PAD   6
#define MCR   7

#define XXX &none
#define ___ &trans

/* Homerow mods */
#define KEYS_L      LT0 LT1 LT2 LT3 LT4 LT5 LM0 LM1 LM2 LM3 LM4 LM5 LB0 LB1 LB2 LB3 LB4 LB5
#define KEYS_R      RT0 RT1 RT2 RT3 RT4 RT5 RM0 RM1 RM2 RM3 RM4 RM5 RB0 RB1 RB2 RB3 RB4 RB5
#ifndef LH2
  #define THUMBS LH1 LH0 RH0 RH1         // Thumbs on 34 keys.
#else
  #define THUMBS LH2 LH1 LH0 RH0 RH1 RH2 // Thumbs on 36+ keys.
#endif
// #define THUMBS      LH2 LH1 LH0 RH0 RH1 RH2
#define ENC_PRESS   LEC
#define JOYSTICK    JS0 JS1 JS2 JS3 JS4

#define J_UP &kp UP
#define J_DW &kp DOWN
#define J_LF &kp LEFT
#define J_RH &kp RIGHT
#define J_CT XXX

// Meh key
// #define MEH LS(LC(LALT))
#define MEH(key) LS(LC(LA(key)))
#define HYP LG(LS(LC(LALT)))

#define ASTRSK KP_ASTERISK

// Homerow aliases.
#define HMR_0 HYP
#define HMR_1 LGUI
#define HMR_2 LALT
#define HMR_3 LCTRL
#define HMR_4 LSHFT
#define HMR_5 GLOBE

#define HM_M5(key) &hml HMR_5 MEH(key)  // GLOBE + MEH
#define HM_M4(key) &hml HMR_4 MEH(key)  // LSHFT + MEH
#define HM_M3(key) &hml HMR_3 MEH(key)  // LCTRL + MEH
#define HM_M2(key) &hml HMR_2 MEH(key)  // LALT + MEH
#define HM_M1(key) &hml HMR_1 MEH(key)  // LGUI + MEH
#define HM_M0(key) &hml HMR_0 MEH(key)  // HYP + MEH


#define _BT_SEL_KEYS_ &bt BT_SEL 0 &bt BT_SEL 1 &bt BT_SEL 2 &bt BT_SEL 3 &bt BT_CLR

/* Global defaults */
#define QUICK_TAP_MS 175

&sk {
  release-after-ms = <900>;
  quick-release;
};

&sl { // Allow sticky mods to chord across sticky layers.
  ignore-modifiers;
};

&lt {
  flavor = "balanced";
  tapping-term-ms = <200>;
  quick-tap-ms = <QUICK_TAP_MS>;
};

#define MAKE_HRM(NAME, HOLD, TAP, TRIGGER_POS)                                 \
  ZMK_HOLD_TAP(NAME, bindings = <HOLD>, <TAP>; flavor = "balanced";            \
               tapping-term-ms = <280>; quick-tap-ms = <QUICK_TAP_MS>;         \
               require-prior-idle-ms = <150>; hold-trigger-on-release;         \
               hold-trigger-key-positions = <TRIGGER_POS>;)

MAKE_HRM(hml, &kp, &kp, KEYS_R THUMBS) // Left-hand HRMs.
MAKE_HRM(hmr, &kp, &kp, KEYS_L THUMBS) // Right-hand HRMs.

// Hack: Make HRM combos tap-only (cf, ZMK issue #544).
#define ZMK_COMBO_8(NAME, TAP, POS, LAYERS, COMBO_MS, IDLE_MS, HOLD, SIDE)     \
  MAKE_HRM(hm_combo_##NAME, &kp, TAP, SIDE THUMBS)                             \
  ZMK_COMBO_6(NAME, &hm_combo_##NAME HOLD 0, POS, LAYERS, COMBO_MS, IDLE_MS)

/* Combos, leader key sequences, mouse emulation */

#include "combos.dtsi" // Must be sourced after HRM-combo hack.
#include "leader.dtsi"
#include "mouse.dtsi"
#include "encoder.dtsi"

/* Nav cluster */

// Trigger tap-action on all interrupts.
#define MT_CORE                                                                \
  flavor = "tap-preferred";                                                    \
  tapping-term-ms = <220>;                                                     \
  quick-tap-ms = <220>;                                                        \
  hold-trigger-key-positions = <0>;

&mt { MT_CORE };

ZMK_HOLD_TAP(mt_home, bindings = <&masked_home>, <&kp>; MT_CORE)
ZMK_HOLD_TAP(mt_end, bindings = <&masked_end>, <&kp>; MT_CORE)

#define NAV_LEFT  &mt_home 0     LEFT  // Tap: left  | Long-tap: start of line.
#define NAV_RIGHT &mt_end 0      RIGHT // Tap: right | Long-tap: end   of line.
#define NAV_UP    &mt LG(UP)     UP    // Tap: up    | Long-tap: start of doc.
#define NAV_DOWN  &mt LG(DOWN)   DOWN  // Tap: down  | Long-tap: end   of doc.
#define NAV_BSPC  &mt LG(BSPC)   BSPC  // Tap: bspc  | Long-tap: delete word bwd.
#define NAV_DEL   &mt LG(DEL)    DEL   // Tap: del   | Long-tap: delete word fwd.

// Mask CTRL on left/right hold to avoid accidental jumps to start/end of doc.
#define MASK_MODS(NAME, MODS, BINDING)                                         \
  ZMK_MOD_MORPH(NAME, bindings = <BINDING>, <BINDING>; mods = <MODS>;)

MASK_MODS(masked_home, (MOD_LCTL), &kp LG(LEFT))
MASK_MODS(masked_end,  (MOD_LCTL), &kp LG(RIGHT))

// A function to wrap the hey in  a meh key (alt +  shift + ctrl) = LS(LA(LC)) using ZMK


/* Magic-shift & auto-layers */

// Tap: repeat after alpha, else sticky-shift |
// Shift + tap/ double-tap: caps-word | Hold: shift.
#define MAGIC_SHIFT &magic_shift LSHFT 0
ZMK_HOLD_TAP(magic_shift, bindings = <&kp>, <&magic_shift_tap>;
             flavor = "balanced"; tapping-term-ms = <200>;
             quick-tap-ms = <QUICK_TAP_MS>;)
ZMK_MOD_MORPH(magic_shift_tap, bindings = <&shift_repeat>, <&caps_word>;
              mods = <(MOD_LSFT)>;)
ZMK_ADAPTIVE_KEY(
    shift_repeat, bindings = <&sk LSHFT>;
    repeat {
      trigger-keys = <A B C D E F G H I J K L M N O P Q R S T U V W X Y Z>;
      bindings = <&key_repeat>;
      max-prior-idle-ms = <1200>;
      strict-modifiers;
    };)
&caps_word { // Mods deactivate caps-word, requires PR #1451. [TODO: rebase]
  /delete-property/ ignore-modifiers;
};

// Tap: num-word | double-tap: sticky num-layer | Hold: num-layer.
#define SMART_NUM &smart_num NUM 0
ZMK_HOLD_TAP(smart_num, bindings = <&mo>, <&num_dance>; flavor = "balanced";
             tapping-term-ms = <200>; quick-tap-ms = <QUICK_TAP_MS>;)
ZMK_TAP_DANCE(num_dance, bindings = <&num_word NUM>, <&sl NUM>;
              tapping-term-ms = <200>;)

#define SMART_PAD &smart_pad MIC 0
ZMK_HOLD_TAP(smart_pad, bindings = <&mo>, <&pad_dance>; flavor = "balanced";
             tapping-term-ms = <200>; quick-tap-ms = <QUICK_TAP_MS>;)
// TODO get used to new position of ESC, then come back here to remap this
// ZMK_TAP_DANCE(pad_dance, bindings = <&kp ESC>, <&to PAD>;
ZMK_TAP_DANCE(pad_dance, bindings = <XXX>, <XXX>;
              tapping-term-ms = <200>;)

// Smart-mouse, requires tri-state module.
ZMK_TRI_STATE(
    smart_mouse, bindings = <&tog MIC>, <&none>, <&tog MIC>;
    ignored-key-positions =
        <LT1 LT2 LH0 LH1 RT1 RT2 RT3 RM0 RM1 RM2 RM3 RM4 RB1 RB2 RB3 RH0 RH1>;
    ignored-layers = <MIC NAV FN>;)

/* Custom behaviors */

// Alt+Tab swapper, requires tri-state module.
ZMK_TRI_STATE(swapper, bindings = <&kt LALT>, <&kp TAB>, <&kt LALT>;
              ignored-key-positions = <LT2 RT2 RM1 RM2 RM3>;)

// Define mod-morph with a *single* mod trigger for less repetition.
#define SIMPLE_MORPH(NAME, MOD, BINDING1, BINDING2)                            \
  ZMK_MOD_MORPH(NAME, mods = <(MOD_L##MOD | MOD_R##MOD)>;                      \
                bindings = <BINDING1>, <BINDING2>;)

// Tap: comma | Shift + tap: semicolon | Ctrl + shift + tap: <.
SIMPLE_MORPH(comma_morph, SFT, &kp COMMA, &comma_inner_morph)
SIMPLE_MORPH(comma_inner_morph, CTL, &kp SEMICOLON, &kp LESS_THAN)

// Tap: dot | Shift + tap: colon | Ctrl + shift + tap: >.
SIMPLE_MORPH(dot_morph, SFT, &kp DOT, &dot_inner_morph)
SIMPLE_MORPH(dot_inner_morph, CTL, &kp COLON, &kp GREATER_THAN)

// Tap: qmark | Shift + tap: excl.
SIMPLE_MORPH(qexcl, SFT, &kp QMARK, &kp EXCL)

// Tap: left/right parenthesis | Shft + tap: less-than/greater-than.
SIMPLE_MORPH(lpar_lt, SFT, &kp LPAR, &kp LT)
SIMPLE_MORPH(rpar_gt, SFT, &kp RPAR, &kp GT)

// Tap: space | Shift + tap: dot -> space -> sticky shift | Hold: nav layer.
ZMK_HOLD_TAP(lt_spc, bindings = <&mo>, <&spc_morph>; flavor = "balanced";
             tapping-term-ms = <200>; quick-tap-ms = <QUICK_TAP_MS>;)
SIMPLE_MORPH(spc_morph, SFT, &kp SPACE, &dot_spc)
ZMK_MACRO(dot_spc, bindings = <&kp DOT &kp SPACE &sk LSHFT>; wait-ms = <0>;
          tap-ms = <5>;)

// Tap: backspace | Lshft + tap: delete | Rshft + tap: shift-delete.
ZMK_MOD_MORPH(bs_del, bindings = <&kp BSPC>, <&kp DEL>;
              mods = <(MOD_LSFT|MOD_RSFT)>; keep-mods = <MOD_RSFT>;)

// Tap: copy | double-tap: cut.
ZMK_TAP_DANCE(copy_cut, bindings = <&kp LC(INS)>, <&kp LC(X)>;
              tapping-term-ms = <200>;)

// Sticky shift + leader.
ZMK_MACRO(leader_sft, bindings = <&sk LSHFT &leader>;)

// Misc aliases. [TODO: clean up]
#define CANCEL    &kp K_CANCEL            // Cancel caps-word & auto-layers.
#define DSK_PREV  &hmr LCTRL LG(LC(LEFT)) // Previous desktop.
#define DSK_NEXT  &hmr LALT LG(LC(RIGHT)) // Next     desktop.
#define PIN_WIN   &kp LG(LC(LS(Q)))       // Pin window across desktops.
#define PIN_APP   &kp LG(LC(LS(A)))       // Pin application across desktops.
#define DSK_MGR   &kp LA(GRAVE)           // Desktop manager.
#define VOL_DOWN  &hmr RSHFT C_VOL_DN


/* Keymap */
// ZMK_MACRO_ONE_PARAM(kmeh,
//     wait-ms = <0>;
//     tap-ms = <0>;
//     bindings 
//         = <&macro_press &kp LA(LC(RSHFT))>
//         , <&macro_param_1to1>
//         , <&macro_release &kp LA(LC(RSHFT))>
// )

// Homerow mods, left-hand side on nav layer.
// #define N_HMR0     &hmr HMR_0 &meh G
// #define N_HMR1     &hmr HMR_1 &meh T
// #define N_HMR2     &hmr HMR_2 &meh S
// #define N_HMR3     &hmr HMR_3 &meh R
// #define N_HMR4     &hmr HMR_4 &meh A
// #define N_HMR5     &hmr HMR_5 &meh XXX

ZMK_CONDITIONAL_LAYER(sys, FN NUM, SYS) // FN + NUM --> SYS.
//
// #ifndef ZMK_BASE_LAYER
//   #define ZMK_BASE_LAYER(name, LT, MT, RT, LM, MM, RM, LB, MB, RB, LH, RH)                 \
//       ZMK_LAYER(name, LT JS0 RT LM JS1 JS2 JS3 RM LB ENC_PRESS JS4 RB LH RH)
// #endif

ZMK_LAYER(Base,
//╭─────────────┬─────────────┬─────────────┬─────────────┬─────────────┬─────────────╮                       ╭────────╮            ╭─────────────┬─────────────┬─────────────┬─────────────┬─────────────┬─────────────╮
    &lt MCR Q     &kp Q         &kp W         &kp F         &kp P         &kp B                                 J_UP                  &kp J         &kp L         &kp U         &kp Y         &kp SQT       &kp SQT
//├─────────────┼─────────────┼─────────────┼─────────────┼─────────────┼─────────────┤              ╭────────┼────────┼────────╮   ├─────────────┼─────────────┼─────────────┼─────────────┼─────────────┼─────────────┤
    &hml HMR_5 A  &hml HMR_4 A  &hml HMR_3 R  &hml HMR_2 S  &hml HMR_1 T  &hml HMR_0 G                 J_LF     J_CT     J_RH         &hmr HMR_0 M  &hmr HMR_1 N  &hmr HMR_2 E  &hmr HMR_3 I  &hmr HMR_4 O  &hmr HMR_5 K
//├─────────────┼─────────────┼─────────────┼─────────────┼─────────────┼─────────────┤   ╭────────╮ ╰────────┼────────┼────────╯   ├─────────────┼─────────────┼─────────────┼─────────────┼─────────────┼─────────────┤
    &kp Q         &kp Z         &kp X         &kp C         &kp D         &kp V             ___                 J_DW                  &kp K         &kp H         &comma_morph  &dot_morph    &qexcl        &kp SQT
//╰─────────────┴─────────────┴─────────────┼─────────────┼─────────────┼─────────────┤   ╰────────╯          ╰────────╯            ├─────────────┼─────────────┼─────────────┼─────────────┴─────────────┴─────────────╯
                                              SMART_PAD     &lt MCR ESC   &lt NAV SPACE                                               &lt PAD RET   &lt NUM TAB   MAGIC_SHIFT
//                                          ╰─────────────┴─────────────┴─────────────╯                                             ╰─────────────┴─────────────┴─────────────╯
)

ZMK_LAYER(Nav,
//╭─────────────┬─────────────┬─────────────┬─────────────┬─────────────┬─────────────╮                       ╭────────╮            ╭─────────────┬─────────────┬─────────────┬─────────────┬─────────────┬─────────────╮
    ___           &kp MEH(Q)    &kp MEH(W)    &kp MEH(F)    &kp MEH(P)    &kp MEH(B)                            ___                   ___           ___           ___           ___           ___           ___
//├─────────────┼─────────────┼─────────────┼─────────────┼─────────────┼─────────────┤              ╭────────┼────────┼────────╮   ├─────────────┼─────────────┼─────────────┼─────────────┼─────────────┼─────────────┤
    &kp HMR_5     HM_M0(A)      HM_M0(R)      HM_M0(S)      HM_M0(T)      HM_M0(G)                     ___      ___      ___          ___           NAV_LEFT      NAV_DOWN      NAV_UP        NAV_RIGHT     ___
//├─────────────┼─────────────┼─────────────┼─────────────┼─────────────┼─────────────┤   ╭────────╮ ╰────────┼────────┼────────╯   ├─────────────┼─────────────┼─────────────┼─────────────┼─────────────┼─────────────┤
    ___           &kp MEH(Z)    &kp MEH(X)    &kp MEH(C)    &kp MEH(D)    &kp MEH(V)        ___                 ___                   ___           &kp HOME      &kp PG_DN     &kp PG_UP     &kp END       ___
//╰─────────────┴─────────────┴─────────────┼─────────────┼─────────────┼─────────────┤   ╰────────╯          ╰────────╯            ├─────────────┼─────────────┼─────────────┼─────────────┴─────────────┴─────────────╯
                                              ___           ___           ___                                                         ___           ___           ___
//                                          ╰─────────────┴─────────────┴─────────────╯                                             ╰─────────────┴─────────────┴─────────────╯
)

ZMK_LAYER(Fn,
//╭─────────────┬─────────────┬─────────────┬─────────────┬─────────────┬─────────────╮                       ╭────────╮           ╭─────────────┬─────────────┬─────────────┬─────────────┬─────────────┬─────────────╮
    ___           &kp F9        &kp F10       &kp F11       &kp F12       ___                                   ___                  ___           ___           ___           ___           ___           ___
//├─────────────┼─────────────┼─────────────┼─────────────┼─────────────┼─────────────┤              ╭────────┼────────┼────────╮  ├─────────────┼─────────────┼─────────────┼─────────────┼─────────────┼─────────────┤
   ___            &kp F5 &hml   &kp F6        &kp F7        &kp F8       ___                           ___      ___      ___          &kp HMR_0     &kp HMR_1     &kp HMR_2     &kp HMR_3     &kp HMR_4     &kp HMR_5 
//├─────────────┼─────────────┼─────────────┼─────────────┼─────────────┼─────────────┤   ╭────────╮ ╰────────┼────────┼────────╯  ├─────────────┼─────────────┼─────────────┼─────────────┼─────────────┼─────────────┤
    ___           &kp F1        &kp F2        &kp F3        &kp F4        ___               ___                 ___                  ___           ___           ___           ___           ___           ___
//╰─────────────┴─────────────┴─────────────┼─────────────┼─────────────┼─────────────┤   ╰────────╯          ╰────────╯           ├─────────────┼─────────────┼─────────────┼─────────────┴─────────────┴─────────────╯
                                              ___           ___           ___                                                        ___           ___           CANCEL
//                                          ╰─────────────┴─────────────┴─────────────╯                                            ╰─────────────┴─────────────┴─────────────╯
)

ZMK_LAYER(Num,
//╭─────────────┬─────────────┬─────────────┬─────────────┬─────────────┬─────────────╮                       ╭────────╮            ╭─────────────┬─────────────┬─────────────┬─────────────┬─────────────┬─────────────╮
    ___           ___           &kp N7        &kp N8        &kp N9        ___                                   ___                   ___           ___           ___           ___           ___           ___
//├─────────────┼─────────────┼─────────────┼─────────────┼─────────────┼─────────────┤              ╭────────┼────────┼────────╮   ├─────────────┼─────────────┼─────────────┼─────────────┼─────────────┼─────────────┤
    ___           ___           &kp N4        &kp N5        &kp N6        ___                          ___      ___      ___          &kp HMR_5     &kp HMR_4     &kp HMR_3     &kp HMR_2     &kp HMR_1     &kp HMR_0
//├─────────────┼─────────────┼─────────────┼─────────────┼─────────────┼─────────────┤   ╭────────╮ ╰────────┼────────┼────────╯   ├─────────────┼─────────────┼─────────────┼─────────────┼─────────────┼─────────────┤
    ___           ___           &kp N1        &kp N2        &kp N3        ___               ___                 ___                   ___           ___           ___           ___           ___           ___
//╰─────────────┴─────────────┴─────────────┼─────────────┼─────────────┼─────────────┤   ╰────────╯          ╰────────╯            ├─────────────┼─────────────┼─────────────┼─────────────┴─────────────┴─────────────╯
                                              ___           &kp N0        ___                                                         ___           ___           CANCEL
//                                          ╰─────────────┴─────────────┴─────────────╯                                             ╰─────────────┴─────────────┴─────────────╯
)

ZMK_LAYER(Sys,
//╭─────────────┬─────────────┬─────────────┬─────────────┬─────────────┬─────────────╮                       ╭────────╮            ╭─────────────┬─────────────┬─────────────┬─────────────┬─────────────┬─────────────╮
    ___           &kp ASTRSK    &kp KP_N7     &kp KP_N8     &kp KP_N9     &kp KP_EQUAL                          ___                   ___           ___           ___           ___           ___           ___
//├─────────────┼─────────────┼─────────────┼─────────────┼─────────────┼─────────────┤              ╭────────┼────────┼────────╮   ├─────────────┼─────────────┼─────────────┼─────────────┼─────────────┼─────────────┤
    ___           &kp KP_SLASH  &kp KP_N4     &kp KP_N5     &kp KP_N6     &kp KP_MINUS                 ___      ___      ___          &kp HMR_5     &kp HMR_4     &kp HMR_3     &kp HMR_2     &kp HMR_1     &kp HMR_0
//├─────────────┼─────────────┼─────────────┼─────────────┼─────────────┼─────────────┤   ╭────────╮ ╰────────┼────────┼────────╯   ├─────────────┼─────────────┼─────────────┼─────────────┼─────────────┼─────────────┤
    ___           &kp KP_COMMA  &kp KP_N1     &kp KP_N2    &kp KP_N3      &kp KP_PLUS       ___                 ___                   ___           ___           ___           ___           ___           ___
//╰─────────────┴─────────────┴─────────────┼─────────────┼─────────────┼─────────────┤   ╰────────╯          ╰────────╯            ├─────────────┼─────────────┼─────────────┼─────────────┴─────────────┴─────────────╯
                                              &kp KP_DOT    &kp KP_N0     ___                                                         ___           ___           CANCEL
//                                          ╰─────────────┴─────────────┴─────────────╯                                             ╰─────────────┴─────────────┴─────────────╯
)

ZMK_LAYER(Mouse,
//╭─────────────┬─────────────┬─────────────┬─────────────┬─────────────┬─────────────╮                       ╭────────╮            ╭─────────────┬─────────────┬─────────────┬─────────────┬─────────────┬─────────────╮
    ___           &kp ASTRSK    &kp KP_N7     &kp KP_N8     &kp KP_N9     &kp KP_EQUAL                          ___                   ___           ___           ___           ___           ___           ___
//├─────────────┼─────────────┼─────────────┼─────────────┼─────────────┼─────────────┤              ╭────────┼────────┼────────╮   ├─────────────┼─────────────┼─────────────┼─────────────┼─────────────┼─────────────┤
    ___           &kp KP_SLASH  &kp KP_N4     &kp KP_N5     &kp KP_N6     &kp KP_MINUS                 ___      ___      ___          &kp HMR_5     &kp HMR_4     &kp HMR_3     &kp HMR_2     &kp HMR_1     &kp HMR_0
//├─────────────┼─────────────┼─────────────┼─────────────┼─────────────┼─────────────┤   ╭────────╮ ╰────────┼────────┼────────╯   ├─────────────┼─────────────┼─────────────┼─────────────┼─────────────┼─────────────┤
    ___           &kp KP_COMMA  &kp KP_N1     &kp KP_N2    &kp KP_N3      &kp KP_PLUS       ___                 ___                   ___           ___           ___           ___           ___           ___
//╰─────────────┴─────────────┴─────────────┼─────────────┼─────────────┼─────────────┤   ╰────────╯          ╰────────╯            ├─────────────┼─────────────┼─────────────┼─────────────┴─────────────┴─────────────╯
                                              &kp KP_DOT    &kp KP_N0     ___                                                         ___           ___           CANCEL
//                                          ╰─────────────┴─────────────┴─────────────╯                                             ╰─────────────┴─────────────┴─────────────╯
)


ZMK_LAYER(Pad,
//╭─────────────┬─────────────┬─────────────┬─────────────┬─────────────┬─────────────╮                       ╭────────╮            ╭─────────────┬─────────────┬─────────────┬─────────────┬─────────────┬─────────────╮
    &kp LPAR      &kp KP_EQUAL   &kp KP_N7     &kp KP_N8     &kp KP_N9     &kp BSPC                              ___                   ___           ___           ___           ___           ___           ___
//├─────────────┼─────────────┼─────────────┼─────────────┼─────────────┼─────────────┤              ╭────────┼────────┼────────╮   ├─────────────┼─────────────┼─────────────┼─────────────┼─────────────┼─────────────┤
    &kp RPAR      &kp KP_MINUS  &kp KP_N4     &kp KP_N5     &kp KP_N6     &kp KP_PLUS                   ___      ___      ___          &kp HMR_5     &kp HMR_4     &kp HMR_3     &kp HMR_2     &kp HMR_1     &kp HMR_0
//├─────────────┼─────────────┼─────────────┼─────────────┼─────────────┼─────────────┤   ╭────────╮ ╰────────┼────────┼────────╯   ├─────────────┼─────────────┼─────────────┼─────────────┼─────────────┼─────────────┤
    &to 0         &kp KP_SLASH  &kp KP_N1     &kp KP_N2    &kp KP_N3      &kp ASTRSK        ___                 ___                   ___           ___           ___           ___           ___           ___
//╰─────────────┴─────────────┴─────────────┼─────────────┼─────────────┼─────────────┤   ╰────────╯          ╰────────╯            ├─────────────┼─────────────┼─────────────┼─────────────┴─────────────┴─────────────╯
                                              &kp KP_DOT    &kp KP_N0     ___                                                         ___           ___           CANCEL
//                                          ╰─────────────┴─────────────┴─────────────╯                                             ╰─────────────┴─────────────┴─────────────╯
)

ZMK_LAYER(Macro,
//╭─────────────┬─────────────┬─────────────┬─────────────┬─────────────┬─────────────╮                       ╭────────╮            ╭─────────────┬─────────────┬─────────────┬─────────────┬─────────────┬─────────────╮
    ___            ___          ___           ___           ___           ___                                   ___                   ___           ___           ___           ___           ___           ___
//├─────────────┼─────────────┼─────────────┼─────────────┼─────────────┼─────────────┤              ╭────────┼────────┼────────╮   ├─────────────┼─────────────┼─────────────┼─────────────┼─────────────┼─────────────┤
    ___            ___          ___           ___           ___           ___                          ___      ___      ___          ___           ___           ___           ___           ___           ___
//├─────────────┼─────────────┼─────────────┼─────────────┼─────────────┼─────────────┤   ╭────────╮ ╰────────┼────────┼────────╯   ├─────────────┼─────────────┼─────────────┼─────────────┼─────────────┼─────────────┤
    ___            ___          ___           ___           ___           ___               ___                 ___                   ___           ___           ___           ___           ___           ___
//╰─────────────┴─────────────┴─────────────┼─────────────┼─────────────┼─────────────┤   ╰────────╯          ╰────────╯            ├─────────────┼─────────────┼─────────────┼─────────────┴─────────────┴─────────────╯
                                              ___           ___           ___                                                         ___           ___           ___
//                                          ╰─────────────┴─────────────┴─────────────╯                                             ╰─────────────┴─────────────┴─────────────╯
)

// ZMK_BASE_LAYER(Nav,
// //╭─────────────┬─────────────┬─────────────┬─────────────┬─────────────╮ ╭─────────────┬─────────────┬─────────────┬─────────────┬─────────────╮
//     &kp LA(F4)    ___           &kp LS(TAB)   &swapper      ___         ,   &kp PG_UP     NAV_BSPC      NAV_UP        NAV_DEL       ___         ,
// //├─────────────┼─────────────┼─────────────┼─────────────┼─────────────┤ ├─────────────┼─────────────┼─────────────┼─────────────┼─────────────┤
//     &sk LGUI      &sk LALT      &sk LSHFT     &sk LCTRL     ___         ,   &kp PG_DN     NAV_LEFT      NAV_DOWN      NAV_RIGHT     &kp RET     ,
// //├─────────────┼─────────────┼─────────────┼─────────────┼─────────────┤ ├─────────────┼─────────────┼─────────────┼─────────────┼─────────────┤
//     ___           ___           ___           ___           ___         ,   &kp INS       &kp TAB       ___           ___           ___         ,
// //╰─────────────┼─────────────┴─────────────┼─────────────┼─────────────┤ ├─────────────┼─────────────┼─────────────┴───────────────────────────╯
//                                               ___           ___         ,   ___           CANCEL
// //                                          ╰─────────────┴─────────────╯ ╰─────────────┴─────────────╯
// )
//
// ZMK_BASE_LAYER(Fn,
// //╭─────────────┬─────────────┬─────────────┬─────────────┬─────────────╮ ╭─────────────┬─────────────┬─────────────┬─────────────┬─────────────╮
//     &kp F12       &kp F7        &kp F8        &kp F9        ___         ,   ___           &kp C_PREV    &kp C_VOL_UP  &kp C_NEXT    ___         ,
// //├─────────────┼─────────────┼─────────────┼─────────────┼─────────────┤ ├─────────────┼─────────────┼─────────────┼─────────────┼─────────────┤
//     &hml LGUI F11 &hml LALT F4  &hml LSHFT F5 &hml LCTRL F6 ___         ,   ___           DSK_PREV      VOL_DOWN      DSK_NEXT      ___         ,
// //├─────────────┼─────────────┼─────────────┼─────────────┼─────────────┤ ├─────────────┼─────────────┼─────────────┼─────────────┼─────────────┤
//     &kp F10       &kp F1        &kp F2        &kp F3        ___         ,   PIN_APP       PIN_WIN       DSK_MGR       ___           ___         ,
// //╰─────────────┼─────────────┴─────────────┼─────────────┼─────────────┤ ├─────────────┼─────────────┼─────────────┴───────────────────────────╯
//                                               ___           ___         ,   &kp C_MUTE    &kp C_PP
// //                                          ╰─────────────┴─────────────╯ ╰─────────────┴─────────────╯
// )
//
// ZMK_BASE_LAYER(Num,
// //╭─────────────┬─────────────┬─────────────┬─────────────┬─────────────╮ ╭─────────────┬─────────────┬─────────────┬─────────────┬─────────────╮
//     ___           &kp N7        &kp N8        &kp N9        ___         ,   ___           ___           ___           ___           ___         ,
// //├─────────────┼─────────────┼─────────────┼─────────────┼─────────────┤ ├─────────────┼─────────────┼─────────────┼─────────────┼─────────────┤
//     &hml LGUI N0  &hml LALT N4  &hml LSHFT N5 &hml LCTRL N6 ___         ,   ___           ___           ___           ___           ___         ,
// //├─────────────┼─────────────┼─────────────┼─────────────┼─────────────┤ ├─────────────┼─────────────┼─────────────┼─────────────┼─────────────┤
//     ___           &kp N1        &kp N2        &kp N3        ___         ,   ___           ___           ___           ___           ___         ,
// //╰─────────────┼─────────────┴─────────────┼─────────────┼─────────────┤ ├─────────────┼─────────────┼─────────────┴───────────────────────────╯
//                                               ___           ___         ,   ___           ___
// //                                          ╰─────────────┴─────────────╯ ╰─────────────┴─────────────╯
// )
//
// ZMK_BASE_LAYER(Sys,
// //╭─────────────┬─────────────┬─────────────┬─────────────┬─────────────╮ ╭─────────────┬─────────────┬─────────────┬─────────────┬─────────────╮
//                                _BT_SEL_KEYS_                            ,   ___           ___           ___           ___           ___         ,
// //├─────────────┼─────────────┼─────────────┼─────────────┼─────────────┤ ├─────────────┼─────────────┼─────────────┼─────────────┼─────────────┤
//     ___           ___           ___           ___           &bootloader ,   &bootloader   ___           ___           ___           ___         ,
// //├─────────────┼─────────────┼─────────────┼─────────────┼─────────────┤ ├─────────────┼─────────────┼─────────────┼─────────────┼─────────────┤
//     ___           ___           ___           ___           &sys_reset  ,   &sys_reset    ___           ___           ___           ___         ,
// //╰─────────────┼─────────────┴─────────────┼─────────────┼─────────────┤ ├─────────────┼─────────────┼─────────────┴───────────────────────────╯
//                                               ___           ___         ,   ___           ___
// //                                          ╰─────────────┴─────────────╯ ╰─────────────┴─────────────╯
// )
//
// ZMK_BASE_LAYMouse,
// //╭─────────────┬─────────────┬─────────────┬─────────────┬─────────────╮ ╭─────────────┬─────────────┬─────────────┬─────────────┬─────────────╮
//     ___           ___           ___           ___           ___         ,   ___           &kp PG_UP     U_MS_U         &kp PG_DN    ___         ,
// //├─────────────┼─────────────┼─────────────┼─────────────┼─────────────┤ ├─────────────┼─────────────┼─────────────┼─────────────┼─────────────┤
//     ___           ___           ___           ___           ___         ,   U_WH_L        U_MS_L        U_MS_D         U_MS_R       U_WH_R      ,
// //├─────────────┼─────────────┼─────────────┼─────────────┼─────────────┤ ├─────────────┼─────────────┼─────────────┼─────────────┼─────────────┤
//     ___           ___           ___           ___           ___         ,   ___           &mkp LCLK     &mkp MCLK      &mkp RCLK    ___         ,
// //╰─────────────┼─────────────┴─────────────┼─────────────┼─────────────┤ ├─────────────┼─────────────┼─────────────┴───────────────────────────╯
//                                               ___           ___         ,   U_WH_U        U_WH_D
// //                                          ╰─────────────┴─────────────╯ ╰─────────────┴─────────────╯
// )
//
/* vim: set ft=c tw=146: */
